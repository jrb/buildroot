## configs/globalscale_espressobin_defconfig
```kconfig
BR2_aarch64=y
BR2_TARGET_GENERIC_HOSTNAME="ESPRESSObin"
BR2_TARGET_GENERIC_ISSUE="Welcome to Buildroot for the GlobalScale ESPRESSObin"
BR2_GLOBAL_PATCH_DIR="board/globalscale/espressobin/patches"

# Kernel
BR2_LINUX_KERNEL=y
BR2_LINUX_KERNEL_USE_ARCH_DEFAULT_CONFIG=y
BR2_LINUX_KERNEL_DTS_SUPPORT=y
BR2_LINUX_KERNEL_INTREE_DTS_NAME="marvell/armada-3720-espressobin"
BR2_LINUX_KERNEL_INSTALL_TARGET=y

# rootfs
BR2_TARGET_ROOTFS_TAR=y
BR2_TARGET_ROOTFS_EXT2=y
BR2_TARGET_ROOTFS_EXT2_4=y
BR2_PACKAGE_HOST_GENIMAGE=y
BR2_ROOTFS_POST_IMAGE_SCRIPT="support/scripts/genimage.sh"
BR2_ROOTFS_POST_SCRIPT_ARGS="-c board/globalscale/espressobin/genimage.cfg"
BR2_ROOTFS_POST_BUILD_SCRIPT="board/globalscale/espressobin/post-build.sh"
```
